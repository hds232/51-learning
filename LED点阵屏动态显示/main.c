#include <STC89C5xRC.H>
#include "Mscreen.h"
#include "Timer0.h"

unsigned char offset;
unsigned char code Character[]={
	0x00,0x00,0x00,0x00,0x00,0x00,0x00,0x00,
	0xFF,0x08,0x08,0x08,0x08,0xFF,0x00,0x1F,0x68,0x88,0x88,0x68,0x1F,0x00,0xFF,0x88,
	0x88,0x88,0x70,0x00,0xFF,0x88,0x88,0x88,0x70,0x00,0xC0,0x30,0x10,0x1F,0x10,0x30,
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	0x00,0x00,0x00,0x00,0x00,0x00,0x00,0x00
	};
	//显示HAPPY BIRTHDAY!
	
void main()
{
	unsigned char i;
	Mscreen_Init();
	Timer0_Init();
	while(1)
	{
		for(i=0;i<8;i++)
		{
			Mscreen(i, Character[i+offset]);
		}
	}
}

void Timer0_Routine()	interrupt 1
{
	static unsigned char count=0;
	count++;
	
	TL0 = 0x66;
	TH0 = 0xFC;
	
	if(count==250)
	{
		count=0;
		offset++;
		if(offset>=106)		//数组Character[]中数的个数-8
			offset=0;
	}
}
/**@brief  利用定时器0来控制点阵屏的显示速度
  *@param  count 每加一offset增加时间提高1ms
  *@retval 无
  */